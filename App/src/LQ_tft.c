#include "LQ_tft.h"

uint8_t ColumnarMAX=5;
uint8_t Start_X,Start_Y;
uint8_t AreaW,AreaH;
uint8_t Colum_W,Colum_H;
uint16_t BColor,FColor;

/*--------------------------------------------------------------
//字库码的引索
(0)  !(1)  "(2)  #(3)  $(4)  %(5)  &(6)  '(7)
((8)  )(9)  *(10) +(11) ,(12) -(13) .(14) /(15)
0(16) 1(17) 2(18) 3(19) 4(20) 5(21) 6(22) 7(23)
8(24) 9(25) :(26) ;(27) <(28) =(29) >(30) ?(31)
@(32) A(33) B(34) C(35) D(36) E(37) F(38) G(39)
H(40) I(41) J(42) K(43) L(44) M(45) N(46) O(47)
P(48) Q(49) R(50) S(51) T(52) U(53) V(54) W(55)
X(56) Y(57) Z(58) [(59) \(60) ](61) ^(62) _(63)
`(64) a(65) b(66) c(67) d(68) e(69) f(70) g(71)
h(72) i(73) j(74) k(75) l(76) m(77) n(78) o(79)
p(80) q(81) r(82) s(83) t(84) u(85) v(86) w(87)
x(88) y(89) z(90) {(91) |(92) }(93) ~(94)
--------------------------------------------------------------*/
//	  字体:	8*6字体
//取码规则:	低位在前, 列行扫描, 阴码(1-亮, 0-灭)
//查表方法: 要显示的ASCII码-32就可以得到字库码的指针
unsigned char Font_code8[][6] = {
  {0x00,0x00,0x00,0x00,0x00,0x00},// (0)
  {0x00,0x00,0x00,0x4F,0x00,0x00},//!(1)
  {0x00,0x00,0x07,0x00,0x07,0x00},//"(2)
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  {0x00,0x1C,0x22,0x44,0x22,0x1C}};//爱心(132)


/*--------------------------------------------------------------*/
//	  字体:	GulimChe12
//取码规则:	高位在前, 行列扫描, 阴码(1-亮, 0-灭)
//查表方法: 要显示的ASCII码-32就可以得到字库码的指针
unsigned char Font_code16[][16] = {
  {0x00,0x00,0x00,0x00,0x00,0x00,0x00,0x00,0x00,0x00,0x00,0x00,0x00,0x00,0x00,0x00},// (0)
  {0x00,0x00,0x10,0x10,0x10,0x10,0x10,0x10,0x10,0x10,0x00,0x00,0x10,0x10,0x00,0x00},//!(1)
  {0x00,0x00,0x24,0x24,0x24,0x24,0x00,0x00,0x00,0x00,0x00,0x00,0x00,0x00,0x00,0x00},//"(3)
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  {0x00,0x00,0x00,0x00,0x00,0x00,0x8C,0x72,0x00,0x00,0x00,0x00,0x00,0x00,0x00,0x00},
};


void TFT_Delay(long t)
{
     while(t--)
    {
        uint16_t a=10;
        while(a--)
        {
        }
    }
}

void TFTSPI_WriteCommand(uint8_t dat)			//写命令
{
    TFT_DC(0);
#if SIM_SPI
	SPI_enable(SPI_ENABLE);
	SPI_write(dat);
	SPI_enable(SPI_DISABLE);
#else
	spi_mosi(spi0,SPI_PCS0,&dat,&dat,1);
#endif
}

void TFTSPI_WriteData(uint8_t dat)			//写数据
{
    TFT_DC(1);
#if SIM_SPI
	SPI_enable(SPI_ENABLE);
	SPI_write(dat);
	SPI_enable(SPI_DISABLE);
#else
	spi_mosi(spi0,SPI_PCS0,&dat,&dat,1);
#endif
}

void TFTSPI_WriteData_16Bit(uint16_t dat)	//向液晶屏写一个16位数据
{
    uint8_t h,l;
    h = dat >> 8;
    l = (uint8_t)dat;

    TFT_DC(1);

#if SIM_SPI
	SPI_enable(SPI_ENABLE);
	SPI_write(h);
	SPI_write(l);
	SPI_enable(SPI_DISABLE);
#else
	spi_mosi(spi0,SPI_PCS0,&h,&h,1); 	//写入高8位数据
    spi_mosi(spi0,SPI_PCS0,&l,&l,1);	//写入低8位数据
#endif
}

void TFT_Init(void)
{
#if SIM_SPI
    SPI_init(); //软件SPI初始化
#else
	spi_init(spi0,SPI_PCS0, MASTER,25*1000*1000);//硬件SPI初始化
#endif

    gpio_init(TFT_DC_PIN, GPO, 0);
    gpio_init(TFT_REST_PIN, GPO, 0);

    TFT_REST(0);
    TFT_Delay(50);
    TFT_REST(1);
    TFT_Delay(50);
    TFTSPI_WriteCommand(0x11);
    TFT_Delay(5);
    TFTSPI_WriteCommand(0x3a);       		  	//每次传送16位数据(VIPF3-0=0101)，每个像素16位(IFPF2-0=101)
    TFTSPI_WriteData(0x55);
    TFTSPI_WriteCommand(0x26);
    TFTSPI_WriteData(0x04);
    TFTSPI_WriteCommand(0xf2);              		//Driver Output Control(1)
    TFTSPI_WriteData(0x01);
    TFTSPI_WriteCommand(0xe0);              		//Driver Output Control(1)
    TFTSPI_WriteData(0x3f);
    TFTSPI_WriteData(0x25);
    TFTSPI_WriteData(0x1c);
    TFTSPI_WriteData(0x1e);
    TFTSPI_WriteData(0x20);
    TFTSPI_WriteData(0x12);
    TFTSPI_WriteData(0x2a);
    TFTSPI_WriteData(0x90);
    TFTSPI_WriteData(0x24);
    TFTSPI_WriteData(0x11);
    TFTSPI_WriteData(0x00);
    TFTSPI_WriteData(0x00);
    TFTSPI_WriteData(0x00);
    TFTSPI_WriteData(0x00);
    TFTSPI_WriteData(0x00);
    TFTSPI_WriteCommand(0xe1);              //Driver Output Control(1)
    TFTSPI_WriteData(0x20);
    TFTSPI_WriteData(0x20);
    TFTSPI_WriteData(0x20);
    TFTSPI_WriteData(0x20);
    TFTSPI_WriteData(0x05);
    TFTSPI_WriteData(0x00);
    TFTSPI_WriteData(0x15);
    TFTSPI_WriteData(0xa7);
    TFTSPI_WriteData(0x3d);
    TFTSPI_WriteData(0x18);
    TFTSPI_WriteData(0x25);
    TFTSPI_WriteData(0x2a);
    TFTSPI_WriteData(0x2b);
    TFTSPI_WriteData(0x2b);
    TFTSPI_WriteData(0x3a);
    TFTSPI_WriteCommand(0xb1);      //0xb1      	//设置屏幕刷新频率
    TFTSPI_WriteData(0x00);     //0x08		//DIVA=8
    TFTSPI_WriteData(0x00);	    //0x08		//VPA =8，约90Hz
    TFTSPI_WriteCommand(0xb4);              	//LCD Driveing control
    TFTSPI_WriteData(0x07);			//NLA=1,NLB=1,NLC=1
    TFTSPI_WriteCommand(0xc0);              //LCD Driveing control  Power_Control1
    TFTSPI_WriteData(0x0a);
    TFTSPI_WriteData(0x02);
    TFTSPI_WriteCommand(0xc1);              //LCD Driveing control
    TFTSPI_WriteData(0x02);
    TFTSPI_WriteCommand(0xc5);              //LCD Driveing control
    TFTSPI_WriteData(0x4f);
    TFTSPI_WriteData(0x5a);
    TFTSPI_WriteCommand(0xc7);              //LCD Driveing control
    TFTSPI_WriteData(0x40);
    TFTSPI_WriteCommand(0x2a);              //配置MCU可操作的LCD内部RAM横坐标起始、结束参数
    TFTSPI_WriteData(0x00);		//横坐标起始地址0x0000
    TFTSPI_WriteData(0x00);
    TFTSPI_WriteData(0x00);		//横坐标结束地址0x007f(127)
    TFTSPI_WriteData(0xa8);                //7f
    TFTSPI_WriteCommand(0x2b);              //配置MCU可操作的LCD内部RAM纵坐标起始结束参数
    TFTSPI_WriteData(0x00);		//纵坐标起始地址0x0000
    TFTSPI_WriteData(0x00);
    TFTSPI_WriteData(0x00);		//纵坐标结束地址0x009f(159)
    TFTSPI_WriteData(0xb3);                //9f
    TFTSPI_WriteCommand(0x36);              //配置MPU和DDRAM对应关系
#if 1
    TFTSPI_WriteData(0xC0);                //竖屏显示          //MX=1,MY=1
#else
    TFTSPI_WriteData(0xA0);            	//横屏显示
#endif
    TFTSPI_WriteCommand(0xb7);              //LCD Driveing control
    TFTSPI_WriteData(0x00);		//CRL=0
    TFTSPI_WriteCommand(0x29);   		//开启屏幕显示
    TFTSPI_WriteCommand(0x2c);   		//设置为LCD接收数据/命令模式
}

/**********************************************************
函数名称：TFTSPI_Set_Pos()
入口参数：起始终止坐标
出口参数：无
时间：2018/1/26
功能说明：重新定位输入信息位置
其他说明：无
**********************************************************/
void TFTSPI_Set_Pos(uint8_t xs,uint8_t ys,uint8_t xe,uint8_t ye)
{
  TFTSPI_WriteCommand(0x2A);      	//Colulm addRSTs set
  TFTSPI_WriteData(0x00);		//行起始坐标高8位，始终为零
  TFTSPI_WriteData(xs);			//行起始坐标低8位
  TFTSPI_WriteData(0x00);		//行终止坐标高8位，始终为零
  TFTSPI_WriteData(xe);			//行终止坐标低8位
  TFTSPI_WriteCommand(0x2B);      	//Colulm addRSTs set
  TFTSPI_WriteData(0x00);		//列起始坐标高8位，始终为零
  TFTSPI_WriteData(ys);			//列起始坐标低8位
  TFTSPI_WriteData(0x00);		//列终止坐标高8位，始终为零
  TFTSPI_WriteData(ye);			//列终止坐标低8位
  TFTSPI_WriteCommand(0x2C);      	//GRAM接收MCU数据或命令
}

/**********************************************************
函数名称：TFTSPI_Addr_Rst()
入口参数：无
出口参数：无
时间：2018/1/26
功能说明：重置地址
其他说明：无
**********************************************************/
void TFTSPI_Addr_Rst(void)
{
  TFTSPI_WriteCommand(0x2a);     //配置MCU可操作的LCD内部RAM横坐标起始、结束参数
  TFTSPI_WriteData(0x00);       //横坐标起始地址0x0000
  TFTSPI_WriteData(0x00);
  TFTSPI_WriteData(0x00);       //横坐标结束地址0x007f(127)
  TFTSPI_WriteData(0xa8);       //7f
  TFTSPI_WriteCommand(0x2b);     //配置MCU可操作的LCD内部RAM纵坐标起始结束参数
  TFTSPI_WriteData(0x00);       //纵坐标起始地址0x0000
  TFTSPI_WriteData(0x00);
  TFTSPI_WriteData(0x00);       //纵坐标结束地址0x009f(159)
  TFTSPI_WriteData(0xb3);       //9f
  TFTSPI_WriteCommand(0x2C);     //GRAM接收MCU数据或命令
}

/*从第几列开始填充某一行
例：TFTSPI_Show_line(0,5,WHITE);  //填充第五行
TFTSPI_Show_line(2,5,WHITE);  //从第二个字符开始填充第五行
*/
void TFTSPI_Show_Line(uint8_t xs,uint8_t ys,uint16_t color)
{
  unsigned int i,j;

  //TFTSPI_Addr_Rst();
  //填充行
  TFTSPI_Set_Pos(xs*8,ys*16,TFT18W,(ys+1)*16);
  for(i=0;i<TFT18W;i++)      //160
  {
    for(j=0;j<TFT18H;j++)
    {
      TFTSPI_WriteData_16Bit(color);
    }
  }
}

/*
【功能】 填充指定区域
【参数】 起始点x坐标，起始点y坐标，终止点x坐标，终止点y坐标，填充色
*/
void TFTSPI_Fill_Area(uint8_t xs,uint8_t ys,uint8_t xe,uint8_t ye,uint16_t color)
{
  unsigned int i,j;

  TFTSPI_Set_Pos(xs,ys,xe,ye);
  for(i=0;i<(xe-xs);i++)
  {
    for(j=0;j<(ye-ys);j++)
    {
      TFTSPI_WriteData_16Bit(color);
    }
  }
}

/**********************************************************
函数名称：TFTSPI_CLS()
入口参数：color为常用的需要显示的颜色(已经提前定义)，color为
NULL时，则可将不常用颜色放入dat中加以显示
出口参数：无
时间：2012-09-09
功能说明：全屏显示单色画面
其他说明：无
**********************************************************/
void TFTSPI_CLS(uint16_t color)
{
  unsigned int i,j;

  TFTSPI_Addr_Rst();

  for(i=0;i<TFT18W;i++)      //160
  {
    for(j=0;j<TFT18H;j++)
    {
      TFTSPI_WriteData_16Bit(color);
    }
  }
}

/**********************************************************
函数名称：TFTSPI_Draw_part()
入口参数：起始、终止横坐标(0-127)，纵坐标(0-159),显示颜色uint16
出口参数：无
时间：2012-09-09
功能说明：填充矩形区域
其他说明：0<=xs<xe<=127
0<=ys<ye<=159
**********************************************************/
void TFTSPI_Draw_Part(uint8_t xs,uint8_t ys,uint8_t xe,uint8_t ye,uint16_t color_dat)
{
  uint8_t i,j;

  TFTSPI_Set_Pos(xs,ys,xe,ye);
  for(j=0;j<(ye-ys+1);j++)
  {
    for(i=0;i<(xe-xs+1);i++)
    {
      TFTSPI_WriteData_16Bit(color_dat);
    }
  }
}

/**********************************************************
函数名称：TFTSPI_Draw_rectangle()
入口参数：起始、终止横坐标(0-127)，纵坐标(0-159),显示颜色uint16
出口参数：无
时间：2012-09-09
功能说明：画矩形边框
其他说明：0<=xs<xe<=127
0<=ys<ye<=159
**********************************************************/
void TFTSPI_Draw_Rectangle(uint8_t xs,uint8_t ys,uint8_t xe,uint8_t ye,uint16_t color_dat)
{
  TFTSPI_Draw_Line(xs,ys,xs,ye,color_dat);	  //画矩形左边
  TFTSPI_Draw_Line(xe,ys,xe,ye,color_dat);	  //画矩形右边
  TFTSPI_Draw_Line(xs,ys,xe,ys,color_dat);	  //画矩形上边
  TFTSPI_Draw_Line(xs,ye,xe,ye,color_dat);	  //画矩形下边
}

/**********************************************************
函数名称：TFTSPI_Draw_circle()
入口参数：圆心横坐标(0-127)，纵坐标(0-159),半径(0-128),显示颜色uint16
出口参数：无
时间：2012-09-09
功能说明：画圆形边框(仅支持屏幕内画圆)
其他说明：0<=x<=127
0<=y<=159
**********************************************************/
void TFTSPI_Draw_Circle(uint8_t x,uint8_t y,uint8_t r,uint16_t color_dat)
{
  unsigned char dx, dy = r;

  if((x>=r) &&((TFT18W-x)>=r) && (y>=r) && ((TFT18H-y)>=r))		//确定所画圆在屏幕范围内，没有超出最外边，(暂不支持与屏幕边相交)
  {
    for(dx = 0; dx <= r; dx++)
    {
      while((r * r + 1 - dx * dx) < (dy * dy)) dy--;
      TFTSPI_Draw_Dot(x + dx, y - dy, color_dat);
      TFTSPI_Draw_Dot(x - dx, y - dy, color_dat);
      TFTSPI_Draw_Dot(x - dx, y + dy, color_dat);
      TFTSPI_Draw_Dot(x + dx, y + dy, color_dat);

      TFTSPI_Draw_Dot(x + dy, y - dx, color_dat);
      TFTSPI_Draw_Dot(x - dy, y - dx, color_dat);
      TFTSPI_Draw_Dot(x - dy, y + dx, color_dat);
      TFTSPI_Draw_Dot(x + dy, y + dx, color_dat);
    }
  }
}


/**********************************************************
函数名称：TFTSPI_Draw_line()
入口参数：起始、终止横坐标(0-127)，纵坐标(0-159),显示颜色uint16
出口参数：无
时间：2012-09-09
功能说明：画直线
其他说明：0<=xs<xe<=127
0<=ys<ye<=159
**********************************************************/
void TFTSPI_Draw_Line(uint8_t xs,uint8_t ys,uint8_t xe,uint8_t ye,uint16_t color_dat)
{
  uint8_t i,ds;
  int dx,dy,inc_x, inc_y;
  int xerr = 0, yerr = 0;				        //初始化变量

  if(xs==xe)	  						//如果是画垂直线则只需对竖直坐标计数
  {
    TFTSPI_Set_Pos(xs,ys,xe,ye);
    for(i=0;i<(ye-ys+1);i++)
    {
      TFTSPI_WriteData_16Bit(color_dat);
    }
  }
  else if(ys==ye)						//如果是水平线则只需要对水平坐标计数
  {
    TFTSPI_Set_Pos(xs,ys,xe,ye);
    for(i=0;i<(xe-xs+1);i++)
    {
      TFTSPI_WriteData_16Bit(color_dat);
    }
  }
  else								//如果是斜线，则重新计算，使用画点函数画出直线
  {
    dx = xe - xs;						//计算坐标增量
    dy = ye - ys;

    if(dx > 0) inc_x = 1;					//设置单步方向
    else
    {
      inc_x = -1; dx = -dx;
    }
    if(dy > 0) inc_y = 1;					//设置单步方向
    else
    {
      inc_y = -1; dy = -dy;
    }

    if(dx > dy) ds = dx;					//选取基本增量坐标轴
    else		ds = dy;

    for(i = 0; i <= ds+1; i++)					//画线输出
    {
      TFTSPI_Draw_Dot(xs, ys,color_dat);	//画点
      xerr += dx;
      yerr += dy;
      if(xerr > ds)
      {
        xerr -= ds;
        xs   += inc_x;
      }
      if(yerr > ds)
      {
        yerr -= ds;
        ys   += inc_y;
      }
    }
  }
}

/**********************************************************
函数名称：TFTSPI_Draw_Dot()
入口参数：起始横坐标(0-127)，纵坐标(0-159),显示颜色uint16
出口参数：无
时间：2012-09-09
功能说明：画点
其他说明：0<=x<=127
0<=y<=159
**********************************************************/
void TFTSPI_Draw_Dot(uint8_t x,uint8_t y,uint16_t color_dat)
{
  TFTSPI_Set_Pos(x,y,x,y);
  TFTSPI_WriteData_16Bit(color_dat);
}

/*--------------------------------------------------------------*/

/*--------------------------------------------------------------*/
//液晶字符输出(6*8字体)
//x: 0 - 20	(行)
//y: 0 -19	(列)
void TFTSPI_P6X8(uint8_t x, uint8_t y, uint8_t c_dat,uint16_t word_color,uint16_t back_color)
{
  uint8_t i,j;

  TFTSPI_Set_Pos(x*6,y*8,(x+1)*6-1,(y+1)*8-1);			//定位字符显示区域

  for(j=0; j<8; j++)
  {
    for(i=0; i<6; i++)
    {
      if((Font_code8[c_dat-32][i]) & (0x01<<j))
        TFTSPI_WriteData_16Bit(word_color);
      else
        TFTSPI_WriteData_16Bit(back_color);
    }
  }
}

/*--------------------------------------------------------------*/
//液晶字符输出(8*16字体)
//x: 0 -15   (行)
//y: 0 -9  	 (列)
void TFTSPI_P8X16(uint8_t x, uint8_t y, uint8_t c_dat,uint16_t word_color,uint16_t back_color)
{
  uint8_t i,j;

  TFTSPI_Set_Pos(x*8,y*16,(x+1)*8-1,(y+1)*16-1);			//定位字符显示区域

  for(j=0; j <16; j++)
  {
    for(i=0; i<8; i++)
    {
      if((Font_code16[c_dat-32][j]) & (0x01<<i))
        TFTSPI_WriteData_16Bit(word_color);
      else
        TFTSPI_WriteData_16Bit(back_color);
    }
  }
}

/*--------------------------------------------------------------*/
//液晶字符串输出(8*16字体)
//x: 0 - 15 (行)
//y: 0 - 7  (列)
void TFTSPI_P8X16Str(uint8_t x, uint8_t y, uint8_t *s_dat,uint16_t word_color,uint16_t back_color)
{
  while(*s_dat) TFTSPI_P8X16(x++, y, *s_dat++,word_color,back_color);
}


/*--------------------------------------------------------------*/
//液晶字符串输出(6*8字体)
//x: 0 - 20 (行)
//y: 0 -19 (列)
void TFTSPI_P6X8Str(uint8_t x, uint8_t y, uint8_t *s_dat,uint16_t word_color,uint16_t back_color)
{
  while(*s_dat) TFTSPI_P6X8(x++, y, *s_dat++,word_color,back_color);
}

/*--------------------------------------------------------------*/
//定位输出数字
//x: 0 - 20  (行)
//y: 0 - 19 (列)
//num: 0 - 65535	要显示的数字
//num_bit: 0 - 5	数字的位数
void TFTSPI_P6X8NUM(uint8_t x, uint8_t y, uint16_t num, uint8_t num_bit,uint16_t word_color,uint16_t back_color)
{
  char i;
  //uint8_t ii;
  uint8_t dat[6];
  for(i = 0; i < 6; i++) dat[i] = 0; i = 0;	//初始化数据
  while(num / 10)								//拆位
  {
    dat[i] = num % 10 + 48;						        ////转换成asc码
    TFTSPI_P6X8(x + num_bit - i - 1, y, ' ',word_color,back_color);		//清显示区域
    TFTSPI_P6X8(x + num_bit - i - 1, y, dat[i],word_color,back_color);		//输出数值
    num /= 10; i++;
  }
}
/*--------------------------------------------------------------*/

/*--------------------------------------------------------------*/
//液晶字符输出(8*8字体)
//x: 0 - 15	(行)
//y: 0 -19	(列)
void TFTSPI_P8X8(uint8_t x, uint8_t y, uint8_t c_dat,uint16_t word_color,uint16_t back_color)
{
  uint8_t i,j;

  TFTSPI_Set_Pos(x*8,y*8,(x+1)*8-1,(y+1)*8-1);			//定位字符显示区域

  for(j=0; j<8; j++)
  {
    TFTSPI_WriteData_16Bit(back_color);
    for(i=0; i<6; i++)
    {
      if((Font_code8[c_dat-32][i]) & (0x01<<j))
        TFTSPI_WriteData_16Bit(word_color);
      else
        TFTSPI_WriteData_16Bit(back_color);
    }
    TFTSPI_WriteData_16Bit(back_color);
  }
}

/*--------------------------------------------------------------*/
//液晶字符串输出(8*8字体)
//x: 0 - 15 (行)
//y: 0 -19 (列)
void TFTSPI_P8X8Str(uint8_t x, uint8_t y, uint8_t *s_dat,uint16_t word_color,uint16_t back_color)
{
  while(*s_dat) TFTSPI_P8X8(x++, y, *s_dat++,word_color,back_color);
}

/*--------------------------------------------------------------*/
//定位输出数字
//x: 0 - 15  (行)
//y: 0 - 19 (列)
//num: 0 - 65535	要显示的数字
//num_bit: 0 - 5	数字的位数
void TFTSPI_P8X8NUM(uint8_t x, uint8_t y, uint16_t num, uint8_t num_bit,uint16_t word_color,uint16_t back_color)
{
  char i;
  uint8_t ii = num_bit;
  uint8_t dat[6];
  for(i = 0; i < 6; i++) dat[i] = 0; i = 0;	//初始化数据
  while(ii--)								//拆位
  {
    dat[i] = num % 10 + 48;						//转换成asc码
    TFTSPI_P8X8(x + num_bit - i - 1, y, ' ',word_color,back_color);	//清除当前要显示的位置				//清显示区域
    TFTSPI_P8X8(x + num_bit - i - 1, y, dat[i],word_color,back_color);	//显示				//输出数值
    num /= 10; i++;
  }
}

//  起始点x,起始点y,频谱宽度，高度，前景色，背景色
void ColumnarSetting(uint8_t x,uint8_t y, uint8_t w,uint8_t h,uint16_t fclolr,uint16_t bcolor)
{
  Start_X=x;
  Start_Y=y;

  AreaW = w;  //AreaW = Colum_W*ColumnarMAX*2;
  AreaH = h;  //AreaY = Colum_H;

  Colum_W = AreaW/(ColumnarMAX*2);     //TFT18W/40;
  Colum_H = AreaH;                     //TFT18H/2;

  BColor = bcolor;
  FColor = fclolr;
}

void DrawingColumnar(uint8_t t,uint8_t duty,uint8_t cl)
{
  unsigned int i,j;

  //上半截
  TFTSPI_Set_Pos(Start_X+Colum_W*t,Start_Y,Start_X+Colum_W*(t+1),(uint8_t)(Start_Y+Colum_H*(1-duty*0.01)));
  for(i=0;i<Colum_W+2;i++)      //160
  {
    for(j=0;j<Colum_H+2;j++)
    {
      TFTSPI_WriteData_16Bit(BColor);
    }
  }
  //下半截
  TFTSPI_Set_Pos(Start_X+Colum_W*t,(uint8_t)(Start_Y+Colum_H*(1-duty*0.01)),Start_X+Colum_W*(t+1),Start_Y+Colum_H);
  for(i=0;i<Colum_W+2;i++)      //160
  {
    for(j=0;j<Colum_H+2;j++)
    {
      TFTSPI_WriteData_16Bit(FColor);
    }
  }

  if(cl)
  {
    //补充空隙
    TFTSPI_Set_Pos(Start_X+Colum_W*(t+1)+1,Start_Y,Start_X+Colum_W*(t+2),Start_Y+Colum_H);
    for(i=0;i<Colum_W;i++)      //160
    {
      for(j=0;j<Colum_H+2;j++)
      {
        TFTSPI_WriteData_16Bit(BColor);
      }
    }
  }
}

void DrawSpectrum(void)
{
  DrawingColumnar( 0,rand()%101,1);       //画柱形
  DrawingColumnar( 2,rand()%101,1);       //画柱形
  DrawingColumnar( 4,rand()%101,1);       //画柱形
  DrawingColumnar( 6,rand()%101,1);       //画柱形
  DrawingColumnar( 8,rand()%101,1);       //画柱形
  DrawingColumnar(10,rand()%101,0);       //画柱形
}

void TFTSPI_Show_Pic(uint8_t xs,uint8_t ys,uint8_t xe,uint8_t ye,uint8_t *ppic)
{
  unsigned int i,j,k=0;

  TFTSPI_Set_Pos(xs,ys,xe-1,ye);
  for(i=0;i<ye-ys;i++)
  {
    for(j=0;j<xe-xs;j++)
    {
      TFTSPI_WriteData_16Bit(((uint16_t)ppic[k])<<8|ppic[k+1]);
      k++;  k++;
    }
  }
}
/****************显示图片（从单片机的DATA区）********************************/
void TFTSPI_Show_Pic2(uint8_t xs,uint8_t ys,uint8_t w,uint8_t h,uint8_t *ppic)
{
    unsigned int i;
    TFTSPI_Set_Pos(xs,ys,xs+w-1,ys+h);
    for(i=0;i<w*h;i++)
    {
        TFTSPI_WriteData_16Bit((ppic[2*i]<<8)+(ppic[2*i+1])); //高位在前，且两个数据组合成一个16位数据表示像素值
    }
 }

void TFTSPI_Show_Pic3(uint8_t xs,uint8_t ys,uint8_t w,uint8_t h,uint8_t ppic[LCDH][LCDW])
{
    unsigned int i,j;
    TFTSPI_Set_Pos(xs,ys,xs+w-1,ys+h);
    for(i=0;i<h;i+=1)  //
    {
      for(j=0; j<w; j+=1) //
      {
        if(ppic[i][j])
        {
            TFTSPI_WriteData_16Bit(0xffff); //高位在前，且两个数据组合成一个16位数据表示像素值
//        TFTSPI_Draw_Dot(j/2, i/2+20, (ppic[i][2*j]<<8)+(ppic[i][2*j+1]));
        }
        else
        {
            TFTSPI_WriteData_16Bit(0x0000); //高位在前，且两个数据组合成一个16位数据表示像素值
        }

      }

    }
}